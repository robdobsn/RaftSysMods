## Kconfig
```kconfig
menu "RaftSysMods"

config RAFT_SYSMODS_ENABLE_ESPNOW
    bool "Enable ESPNow SysMod"
    default n
    depends on ESP_WIFI_ENABLED
    help
        Build and register the optional ESPNow transport SysMod.

        This pulls in ESPNowManager sources and the esp_wifi component
        dependency so ProtocolExchange traffic can be carried over ESPNow.

endmenu
```

## examples/ESPNowTest/systypes/qtpys3/sdkconfig.defaults
```kconfig
# Define configuration
# Remove/repace these comments to set level to debug/info

# Default log level
CONFIG_LOG_DEFAULT_LEVEL_INFO=y

# Flash size
CONFIG_ESPTOOLPY_FLASHSIZE_4MB=y

# Serial port
CONFIG_ESP_CONSOLE_USB_SERIAL_JTAG=y
CONFIG_ESP_CONSOLE_SECONDARY_NONE=y

# Partition Table
CONFIG_PARTITION_TABLE_CUSTOM=y
CONFIG_PARTITION_TABLE_CUSTOM_FILENAME="build/raft/partitions.csv"

# Bluetooth
CONFIG_BT_ENABLED=y
CONFIG_BT_NIMBLE_ENABLED=y
CONFIG_BT_NIMBLE_ROLE_OBSERVER=n
CONFIG_BT_NIMBLE_CRYPTO_STACK_MBEDTLS=n
CONFIG_BT_NIMBLE_LOG_LEVEL_WARNING=y
CONFIG_BT_NIMBLE_HOST_TASK_STACK_SIZE=6144
CONFIG_BT_NIMBLE_MEM_ALLOC_MODE_EXTERNAL=y


# Common ESP-related
CONFIG_ESP_MAIN_TASK_STACK_SIZE=10000

# FreeRTOS
CONFIG_FREERTOS_HZ=1000

# mDNS
CONFIG_MDNS_PREDEF_NETIF_STA=y

# ESPNow
CONFIG_ESP_WIFI_ENABLED=y
CONFIG_RAFT_SYSMODS_ENABLE_ESPNOW=y
CONFIG_ESP_WIFI_ESPNOW_MAX_ENCRYPT_NUM=0

# Build type
CONFIG_COMPILER_OPTIMIZATION_SIZE=y
CONFIG_COMPILER_OPTIMIZATION_ASSERTIONS_DISABLE=y
```
